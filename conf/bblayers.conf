## conf/bblayers.conf
```bitbake
# POKY_BBLAYERS_CONF_VERSION is increased each time build/conf/bblayers.conf
# changes incompatibly
POKY_BBLAYERS_CONF_VERSION = "2"

BBPATH = "${TOPDIR}"
BBFILES ?= ""

BBLAYERS ?= " \
  /home/cetus/jetson/poky/meta \
  /home/cetus/jetson/poky/meta-poky \
  /home/cetus/jetson/poky/meta-yocto-bsp \
  /home/cetus/jetson/meta-tegra \
  "
```
